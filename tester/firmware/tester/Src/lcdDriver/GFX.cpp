/*
 * GFX.cpp
 *
 *  Created on: 23 gen 2017
 *      Author: paolo
 */
#include <stdlib.h>
#include <algorithm>
#include "GFX.h"

const static uint8_t font16_16Data[] = { 0x00, 0x00, 0x00, 0x00, 0x00, 0x00, 0x00, 0x00, 0x00, 0x00, 0x00, 0x00, 0x00, 0x00, 0x00, 0x00, 0x00, 0x00, 0x00, 0x00, 0x00, 0x00, 0x00, 0x00, 0x00, 0x00,
        0x00, 0x00, 0x00, 0x00, 0x00, 0x00, //  <Space>
        0x00, 0x00, 0x00, 0x00, 0x07, 0x00, 0x0F, 0x80, 0x0F, 0x80, 0x0F, 0x80, 0x0F, 0x80, 0x0F, 0x80, 0x07, 0x00, 0x07, 0x00, 0x00, 0x00, 0x00, 0x00, 0x07, 0x00, 0x07, 0x00, 0x07, 0x00, 0x00, 0x00, // !
        0x00, 0x00, 0x0E, 0x38, 0x0E, 0x38, 0x0E, 0x38, 0x0E, 0x38, 0x06, 0x30, 0x00, 0x00, 0x00, 0x00, 0x00, 0x00, 0x00, 0x00, 0x00, 0x00, 0x00, 0x00, 0x00, 0x00, 0x00, 0x00, 0x00, 0x00, 0x00, 0x00, // "
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        0x00, 0x00, 0x00, 0x00, 0x1F, 0x1C, 0x3B, 0x9C, 0x39, 0xDC, 0x38, 0xF8, 0x00, 0x00, 0x00, 0x00, 0x00, 0x00, 0x00, 0x00, 0x00, 0x00, 0x00, 0x00, 0x00, 0x00, 0x00, 0x00, 0x00, 0x00, 0x00, 0x00 // ~
        };

const unsigned char font8_12Data[] = { 0x00, 0x00, 0x00, 0x00, 0x00, 0x00, 0x00, 0x00, 0x00, 0x00, 0x00, 0x00, // <Space>
        0x00, 0x00, 0x20, 0x20, 0x20, 0x20, 0x20, 0x20, 0x00, 0x20, 0x00, 0x00, // !
        0x00, 0x28, 0x50, 0x50, 0x00, 0x00, 0x00, 0x00, 0x00, 0x00, 0x00, 0x00, // "
        0x00, 0x00, 0x28, 0x28, 0xFC, 0x28, 0x50, 0xFC, 0x50, 0x50, 0x00, 0x00, // #
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        0x40, 0xA4, 0x18, 0x00, 0x00, 0x00, 0x00, 0x00, 0x00, 0x00, 0x00, 0x00 // ~
        };

const Font bigFont = { 16, 16, 0x20, 0x5F, false, font16_16Data };
const Font smallFont = { 8, 12, 0x20, 0x5F, false, font8_12Data };

GFX::GFX() :
        foreground(255, 255, 255), background(0, 0, 0) {
    driver = LcdID::ID_UNKNOWN;
    width = 0xFFFF;
    height = 0xFFFF;
    font = &bigFont;
}

void GFX::drawFastVLine(Point p, uint16_t length, Color6Bit color) {
    int16_t y2;

    // Initial off-screen clipping
    if ((p.x < 0) || (p.x >= width) || (p.y >= height) || ((y2 = (p.y + length - 1)) < 0))
        return;
    if (p.y < 0) {
        length += p.y;
        p.y = 0;
    }
    if (y2 >= height) {
        y2 = height - 1;
        length = y2 - p.y + 1;
    }

    p.x = p.x;
    activeCS();
    setAddrWindow(p.x, p.y, p.x, y2);
    flood(color, length);
    idleCS();
}

void GFX::drawFastHLine(Point p, uint16_t length, Color6Bit color) {
    int16_t x2;

    // Initial off-screen clipping
    if ((p.y < 0) || (p.y >= height) || (p.x >= width) || ((x2 = (p.x + length - 1)) < 0))
        return;

    if (p.x < 0) {        // Clip left
        length += p.x;
        p.x = 0;
    }
    if (x2 >= width) { // Clip right
        x2 = width - 1;
        length = x2 - p.x + 1;
    }

    activeCS();
    setAddrWindow(p.x, p.y, x2, p.y);
    flood(color, length);
    idleCS();
}

void GFX::drawCircle(Point center, int16_t r, Color6Bit color) {
    int16_t f = 1 - r;
    int16_t ddF_x = 1;
    int16_t ddF_y = -2 * r;
    Point p { 0, r };

    drawPixel(Point(center.x, center.y + r), color);
    drawPixel(Point(center.x, center.y - r), color);
    drawPixel(Point(center.x + r, center.y), color);
    drawPixel(Point(center.x - r, center.y), color);

    while (p.x < p.y) {
        if (f >= 0) {
            p.y--;
            ddF_y += 2;
            f += ddF_y;
        }
        p.x++;
        ddF_x += 2;
        f += ddF_x;

        drawPixel(Point { center.x + p.x, center.y + p.y }, color);
        drawPixel(Point { center.x - p.x, center.y + p.y }, color);
        drawPixel(Point { center.x + p.x, center.y - p.y }, color);
        drawPixel(Point { center.x - p.x, center.y - p.y }, color);
        drawPixel(Point { center.x + p.y, center.y + p.x }, color);
        drawPixel(Point { center.x - p.y, center.y + p.x }, color);
        drawPixel(Point { center.x + p.y, center.y - p.x }, color);
        drawPixel(Point { center.x - p.y, center.y - p.x }, color);

    }
}

void GFX::fillCircle(Point c, int16_t r, Color6Bit color) {
    drawFastVLine(Point { c.x, c.y - r }, 2 * r + 1, color);

    fillCircleHelper(c, r, 3, 0, color);
}

void GFX::fillCircleHelper(Point c, int16_t r, uint8_t cornername, int16_t delta, Color6Bit color) {
    int16_t f = 1 - r;
    int16_t ddF_x = 1;
    int16_t ddF_y = -2 * r;
    int16_t x = 0;
    int16_t y = r;

    while (x < y) {
        if (f >= 0) {
            y--;
            ddF_y += 2;
            f += ddF_y;
        }
        x++;
        ddF_x += 2;
        f += ddF_x;

        if (cornername & 0x1) {
            drawFastVLine(Point { c.x + x, c.y - y }, 2 * y + 1 + delta, color);
            drawFastVLine(Point { c.x + y, c.y - x }, 2 * x + 1 + delta, color);
        }
        if (cornername & 0x2) {
            drawFastVLine(Point { c.x - x, c.y - y }, 2 * y + 1 + delta, color);
            drawFastVLine(Point { c.x - y, c.y - x }, 2 * x + 1 + delta, color);
        }
    }
}

void GFX::drawLine(Point start, Point end, Color6Bit color) {
    volatile int16_t dx = abs(end.x - start.x);
    volatile int16_t dy = abs(end.y - start.y);

    if (dx == 0) {
        if (start.y < end.y)
            drawFastVLine(start, dy, color);
        else
            drawFastVLine(end, dy, color);
        return;
    }
    if (dy == 0) {
        if (start.x < end.x)
            drawFastHLine(start, dx, color);
        else
            drawFastHLine(end, dx, color);
        return;
    }

    if (start.x > end.x)
        std::swap(start, end);

    volatile int32_t steep = (((uint32_t) dy) << 16) / dx;
    if (start.y > end.y)
        steep = -steep;
    volatile int32_t y     = (int32_t)start.y<<16;
    volatile int32_t yPrev = (int32_t)start.y<<16;
    for (; start.x <= end.x; start.x++) {
        dy = ((y-yPrev) >> 16);
        uint16_t y1 = (std::min(y,yPrev)>> 16);
        if (dy > 0){
            drawFastVLine(Point(start.x,y1), dy, color);
        } else {
            drawPixel(Point(start.x, y1), color);
        }
        yPrev = y;
        y += steep;
    }
}

void GFX::drawCircleHelper(Point center, int16_t r, uint8_t cornername, Color6Bit color) {
    int16_t f = 1 - r;
    int16_t ddF_x = 1;
    int16_t ddF_y = -2 * r;
    int16_t x = 0;
    int16_t y = r;

    while (x < y) {
        if (f >= 0) {
            y--;
            ddF_y += 2;
            f += ddF_y;
        }
        x++;
        ddF_x += 2;
        f += ddF_x;
        if (cornername & 0x4) {
            drawPixel(Point { center.x + x, center.y + y }, color);
            drawPixel(Point { center.x + y, center.y + x }, color);
        }
        if (cornername & 0x2) {
            drawPixel(Point { center.x + x, center.y - y }, color);
            drawPixel(Point { center.x + y, center.y - x }, color);
        }
        if (cornername & 0x8) {
            drawPixel(Point { center.x - y, center.y + x }, color);
            drawPixel(Point { center.x - x, center.y + y }, color);
        }
        if (cornername & 0x1) {
            drawPixel(Point { center.x - y, center.y - x }, color);
            drawPixel(Point { center.x - x, center.y - y }, color);
        }
    }
}

void GFX::drawRect(Point leftTop, int16_t w, int16_t h, Color6Bit color) {
    drawFastHLine(leftTop, w, color);
    drawFastHLine(Point { leftTop.x, leftTop.y + h - 1 }, w, color);
    drawFastVLine(leftTop, h, color);
    drawFastVLine(Point { leftTop.x + w - 1, leftTop.y }, h, color);
}

void GFX::fillRect(Point && leftTop, int16_t w, int16_t h, Color6Bit color) {
    int16_t x2, y2;

    if ((w <= 0) || (h <= 0) || (leftTop.x >= width) || (leftTop.y >= height) || ((x2 = leftTop.x + w - 1) < 0) || ((y2 = leftTop.y + h - 1) < 0))
        return;
    if (leftTop.x < 0) {
        w += leftTop.x;
        leftTop.x = 0;
    }
    if (leftTop.y < 0) {
        h += leftTop.y;
        leftTop.y = 0;
    }
    if (x2 >= width) {
        x2 = width - 1;
        w = x2 - leftTop.x + 1;
    }
    if (y2 >= height) {
        y2 = height - 1;
        h = y2 - leftTop.y + 1;
    }

    activeCS();
    setAddrWindow(leftTop.x, leftTop.y, x2, y2);
    flood(color, w * h);
    setAddrWindow(0, 0, width - 1, height - 1);
    idleCS();
}

void GFX::drawRoundRect(Point leftTop, int16_t w, int16_t h, int16_t r, Color6Bit color) {
    // smarter version
    drawFastHLine(Point { leftTop.x + r, leftTop.y }, w - 2 * r, color); // Top
    drawFastHLine(Point { leftTop.x + r, leftTop.y + h - 1 }, w - 2 * r, color); // Bottom
    drawFastVLine(Point { leftTop.x, leftTop.y + r }, h - 2 * r, color); // Left
    drawFastVLine(Point { leftTop.x + w - 1, leftTop.y + r }, h - 2 * r, color); // Right
    // draw four corners
    drawCircleHelper(Point { leftTop.x + r, leftTop.y + r }, r, 1, color);
    drawCircleHelper(Point { leftTop.x + w - r - 1, leftTop.y + r }, r, 2, color);
    drawCircleHelper(Point { leftTop.x + w - r - 1, leftTop.y + h - r - 1 }, r, 4, color);
    drawCircleHelper(Point { leftTop.x + r, leftTop.y + h - r - 1 }, r, 8, color);
}

void GFX::fillRoundRect(Point leftTop, int16_t w, int16_t h, int16_t r, Color6Bit color) {
    fillRect(Point(leftTop.x + r, leftTop.y), w - 2 * r, h, color);
    fillCircleHelper(Point { leftTop.x + w - r - 1, leftTop.y + r }, r, 1, h - 2 * r - 1, color);
    fillCircleHelper(Point { leftTop.x + r, leftTop.y + r }, r, 2, h - 2 * r - 1, color);
}

void GFX::drawChar(Point p, unsigned char c, uint8_t size) {
    if ((p.x >= width) || (p.y >= height) || ((p.x + font->xSize * size - 1) < 0) || ((p.y + font->ySize * size - 1) < 0))
        return;

    if (c < font->offset)
        return;
    c -= font->offset;
    if (c > font->numchars)
        return;

    uint8_t dataLen = (font->xSize * font->ySize) / 8;
    const uint8_t * data = font->data + dataLen * c;
    Point pixelPos = p;
    int8_t x;
    int8_t y;
    if (font->row) {
        for (pixelPos.x = p.x, x = 0; x < font->xSize; x++, pixelPos.x += size) {
            uint8_t bit = 1;
            uint8_t row = *data;
            for (pixelPos.y = p.y, y = 0; y < font->xSize; y++, pixelPos.y -= size) {
                putCharPixel(pixelPos, row, size);
                row >>= 1;
                bit++;
                if (bit == 8) {
                    data++;
                    row = *data;
                    bit = 0;
                }
            }
        }
    } else {
        for (pixelPos.y = p.y, y = 0; y < font->ySize; y++, pixelPos.y -= size) {
            uint8_t bit = 1;
            uint8_t col = *data;
            for (pixelPos.x = p.x, x = 0; x < font->xSize; x++, pixelPos.x += size) {
                putCharPixel(pixelPos, col, size);
                col <<= 1;
                bit++;
                if (bit == 8) {
                    data++;
                    col = *data;
                    bit = 0;
                }
            }
        }
    }
}

void GFX::drawString(Point && p, const char * s) {
    while (*s != 0) {
        drawChar(p, *s);
        p.x += font->xSize;
        s++;
    }
}

void GFX::drawChar(Point p, unsigned char c) {
    if ((p.x >= width) || (p.y >= height) || ((p.x + font->xSize - 1) < 0) || ((p.y + font->ySize - 1) < 0))
        return;

    if (c < font->offset)
        return;
    c -= font->offset;
    if (c > font->numchars)
        return;

    uint8_t dataLen = (font->xSize * font->ySize) / 8;
    const uint8_t * data = font->data + dataLen * c;
    Point pixelPos = p;
    int8_t x;
    int8_t y;
    if (font->row) {
        for (pixelPos.x = p.x, x = 0; x < font->xSize; x++, pixelPos.x++) {
            uint8_t bit = 1;
            uint8_t row = *data;
            for (pixelPos.y = p.y, y = 0; y < font->xSize; y++, pixelPos.y--) {
                putCharPixel(pixelPos, row, 1);
                row >>= 1;
                bit++;
                if (bit == 8) {
                    data++;
                    row = *data;
                    bit = 0;
                }
            }
        }
    } else {
        for (pixelPos.y = p.y, y = 0; y < font->ySize; y++, pixelPos.y--) {
            uint8_t bit = 1;
            uint8_t col = *data;
            for (pixelPos.x = p.x, x = 0; x < font->xSize; x++, pixelPos.x++) {
                putCharPixel(pixelPos, col, 1);
                col <<= 1;
                bit++;
                if (bit == 8) {
                    data++;
                    col = *data;
                    bit = 0;
                }
            }
        }
    }
}

void GFX::putCharPixel(Point p, uint8_t bits, uint8_t size) {
    if (bits & 0x80) {
        if (size == 1)
            drawPixel(Point { p }, foreground);
        else {
            fillRect(Point { p }, size, size, foreground);
        }
    } else if (background != foreground) {
        if (size == 1)
            drawPixel(Point { p }, background);
        else {
            fillRect(Point { p }, size, size, background);
        }
    }
}
